VERSION ""

NS_ :

BS_:

BU_:

BO_ 201 Steering_Cmd: 8 Vector__XXX
 SG_ Left_duty : 0|32@1+ (0.1,0) [0|100] "%" Vector__XXX
 SG_ Right_duty : 32|32@1+ (0.1,0) [0|100] "%" Vector__XXX

BO_ 202 Sol_Chk_Cmd: 8 Vector__XXX
 SG_ Sol_Cmd : 0|32@1+ (0.1,0) [0|1] "_" Vector__XXX
 SG_ Chk_Signal : 32|32@1+ (0.1,0) [0|4] "_" Vector__XXX

BO_ 211 Steering_FB: 8 Vector__XXX
 SG_ Left_FB : 0|32@1+ (1.0,0) [0|2000] "mA" Vector__XXX
 SG_ Right_FB : 32|32@1+ (1.0,0) [0|2000] "mA" Vector__XXX

BO_ 212 Sol_Chk_FB: 8 Vector__XXX
 SG_ Sol_FB : 0|32@1+ (1.0,0) [0|1] "_" Vector__XXX
 SG_ Chk_FB : 32|32@1+ (1.0,0) [0|4] "_" Vector__XXX

 BA_DEF_ "BusType" STRING ;
 BA_DEF_DEF_ "BusType" "";
 BA_ "BusType" "CAN";
